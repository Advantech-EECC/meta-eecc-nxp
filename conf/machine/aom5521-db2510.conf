## conf/machine/aom5521-db2510.conf
```bitbake
MACHINEOVERRIDES =. "mx95:"

require conf/machine/imx95-19x19-lpddr5-evk.conf

MACHINE_FEATURES += "pci wifi bluetooth optee"
MACHINE_FEATURES:append:use-nxp-bsp = " nxpwifi-all-pcie nxpwifi-all-sdio jailhouse dpdk xen"

KERNEL_DEVICETREE_BASENAME = "imx95-aom5521-a2"

IMX_SOC_REV:aom5521-db2510 = "A0"

EVK_KERNEL_DEVICETREES := "${KERNEL_DEVICETREE}"
KERNEL_DEVICETREE:remove = "${EVK_KERNEL_DEVICETREES}"
KERNEL_DEVICETREE:append = " \
	./freescale/${KERNEL_DEVICETREE_BASENAME}.dtb \
	./freescale/${KERNEL_DEVICETREE_BASENAME}-auog101uan02.dtb \
	./freescale/${KERNEL_DEVICETREE_BASENAME}-sof.dtb \
"

MACHINE_FEATURES:append:use-nxp-bsp = " nxp9098-pcie"

IMXBOOT_TARGETS_BASENAME = "flash"


DDR_FIRMWARE_NAME = " \
    lpddr5_dmem_v202409.bin \
    lpddr5_dmem_qb_v202409.bin \
    lpddr5_imem_v202409.bin \
    lpddr5_imem_qb_v202409.bin \
"

OEI_CONFIGS = "ddr tcm"
OEI_CORE   = "m33"
OEI_SOC    = "mx95"
DDR_TYPE   = "lpddr5"
OEI_BOARD  = "mx95lp5_aom5521a1_8G"

IMXBOOT_VARIANTS = "alt jailhouse netc rpmsg sof"

OEI_DDR_CONFIG     = "lpddr5_timing"
OEI_DDR_CONFIG_ECC = ""

SYSTEM_MANAGER_CONFIG = \
    "${@bb.utils.contains('IMXBOOT_VARIANT', 'alt',       'mx95alt', \
        bb.utils.contains('IMXBOOT_VARIANT', 'jailhouse', 'mx95evkjailhouse', \
        bb.utils.contains('IMXBOOT_VARIANT', 'netc',      'mx95netc', \
        bb.utils.contains('IMXBOOT_VARIANT', 'rpmsg',     'mx95evkrpmsg', \
        bb.utils.contains('IMXBOOT_VARIANT', 'sof',       'mx95evksof', \
                                                          'mx95evk', d), d), d), d), d)}"

M4_DEFAULT_IMAGE_MX95 = "${@bb.utils.contains('SYSTEM_MANAGER_CONFIG', 'mx95netc', 'imx95-19x19-evk_m7_TCM_netc_share.bin', \
                                                                                   'imx95-19x19-evk_m7_TCM_power_mode_switch.bin', d)}"

# imx-boot (flash.bin) targets based on UBOOT_CONFIG and IMXBOOT_VARIANT
IMXBOOT_TARGETS_SD = " \
    ${@bb.utils.contains('IMXBOOT_VARIANT', 'alt',       '${IMXBOOT_TARGETS_BASENAME}_alt', \
       bb.utils.contains('IMXBOOT_VARIANT', 'jailhouse', '${IMXBOOT_TARGETS_BASENAME}_jailhouse', \
       bb.utils.contains('IMXBOOT_VARIANT', 'netc',      '${IMXBOOT_TARGETS_BASENAME}_netc', \
       bb.utils.contains('IMXBOOT_VARIANT', 'rpmsg',     '${IMXBOOT_TARGETS_BASENAME}_lpboot_sm_a55', \
       bb.utils.contains('IMXBOOT_VARIANT', 'sof',       '${IMXBOOT_TARGETS_BASENAME}_a55', \
                                                         '${IMXBOOT_TARGETS_BASENAME}_all', d), d), d), d), d)} \
"

IMXBOOT_TARGETS = " \
    ${@bb.utils.contains('UBOOT_CONFIG', 'fspi', '${IMXBOOT_TARGETS_BASENAME}_a55_flexspi', '${IMXBOOT_TARGETS_SD}', d)} \
"

IMX_BOOT_SOC_TARGET = "iMX95"
IMX_BOOT_SEEK = "32"

# We have to disable SERIAL_CONSOLE due to auto-serial-console
SERIAL_CONSOLES = "115200;ttyLP0"

IMX_DEFAULT_BSP = "nxp"

UBOOT_CONFIG_BASENAME = "imx95_19x19_evk"

UBOOT_DTB_NAME = "${KERNEL_DEVICETREE_BASENAME}.dtb"
```

## conf/machine/aom5521a1-db2510.conf
```bitbake
MACHINEOVERRIDES =. "mx95:"

require conf/machine/imx95-19x19-lpddr5-evk.conf

MACHINE_FEATURES += "pci wifi bluetooth optee"
MACHINE_FEATURES:append:use-nxp-bsp = " nxpwifi-all-pcie nxpwifi-all-sdio jailhouse dpdk xen"

KERNEL_DEVICETREE_BASENAME = "imx95-aom5521-a1"

IMX_SOC_REV:aom5521a1-db2510 = "A0"

EVK_KERNEL_DEVICETREES := "${KERNEL_DEVICETREE}"
KERNEL_DEVICETREE:remove = "${EVK_KERNEL_DEVICETREES}"
KERNEL_DEVICETREE:append = " \
    ./freescale/${KERNEL_DEVICETREE_BASENAME}.dtb \
    ./freescale/${KERNEL_DEVICETREE_BASENAME}-auog101uan02.dtb \
    ./freescale/${KERNEL_DEVICETREE_BASENAME}-lvds0-auo.dtb \
    ./freescale/${KERNEL_DEVICETREE_BASENAME}-lvds0-auog070vw01-v1.dtb \
    ./freescale/${KERNEL_DEVICETREE_BASENAME}-lvds1-auo.dtb \
    ./freescale/${KERNEL_DEVICETREE_BASENAME}-lvds1-auog070vw01-v1.dtb \
    ./freescale/${KERNEL_DEVICETREE_BASENAME}-lvds-dual.dtb \
    ./freescale/${KERNEL_DEVICETREE_BASENAME}-m2-sdio.dtb \
"

MACHINE_FEATURES:append:use-nxp-bsp = " nxp9098-pcie"

IMXBOOT_TARGETS_BASENAME = "flash"


DDR_FIRMWARE_NAME = " \
    lpddr5_dmem_v202409.bin \
    lpddr5_dmem_qb_v202409.bin \
    lpddr5_imem_v202409.bin \
    lpddr5_imem_qb_v202409.bin \
"

OEI_CONFIGS = "ddr tcm"
OEI_CORE   = "m33"
OEI_SOC    = "mx95"
DDR_TYPE   = "lpddr5"
OEI_BOARD  = "mx95lp5_aom5521a1_8G"

IMXBOOT_VARIANTS = "alt jailhouse netc rpmsg sof"

OEI_DDR_CONFIG     = "lpddr5_timing"
OEI_DDR_CONFIG_ECC = ""

IMXBOOT_TARGETS = " \
    ${@bb.utils.contains('UBOOT_CONFIG', 'fspi', '${IMXBOOT_TARGETS_BASENAME}_a55_flexspi', '${IMXBOOT_TARGETS_SD}', d)} \
"

UBOOT_CONFIG_BASENAME = "imx95_19x19"
```

## conf/machine/aom5521a2-db2510.conf
```bitbake
#@TYPE: Machine
#@NAME: Advantech i.MX 95 AOM-5521 Board
#@SOC: i.MX95
#@DESCRIPTION: Machine configuration for Advantech i.MX 95 AOM-5521 Board
#@MAINTAINER: Advantech RISC SW Team

MACHINEOVERRIDES =. "aom5521:mx95"

require conf/machine/include/imx95-evk.inc

MACHINE_FEATURES:append:use-nxp-bsp = " nxp9098-pcie"

KERNEL_DEVICETREE_BASENAME = "${MACHINE}"

UBOOT_CONFIG_BASENAME = "imx95_aom5521a2"
IMX_SOC_REV:${MACHINE} = "B0"

IMXBOOT_TARGETS_BASENAME = "flash"
OEI_BOARD  = "${@bb.utils.contains('UBOOT_CONFIG', '8G', 'mx95lp5_aom5521a2_8G', \
							  'mx95lp5', d)}"
DDR_TYPE   = "lpddr5"
OEI_CONFIGS = "ddr tcm"
OEI_DDR_CONFIG     = "lpddr5_timing"
OEI_DDR_CONFIG_ECC = ""

DDR_FIRMWARE_NAME = " \
    lpddr5_dmem_v202409.bin \
    lpddr5_dmem_qb_v202409.bin \
    lpddr5_imem_v202409.bin \
    lpddr5_imem_qb_v202409.bin \
"

# Include device trees
KERNEL_DEVICETREE += " \
    freescale/${KERNEL_DEVICETREE_BASENAME}-m2-sdio.dtb \
    freescale/${KERNEL_DEVICETREE_BASENAME}-lvds0-auo.dtb \
    freescale/${KERNEL_DEVICETREE_BASENAME}-lvds1-auo.dtb \
    freescale/${KERNEL_DEVICETREE_BASENAME}-lvds-dual.dtb \
    freescale/${KERNEL_DEVICETREE_BASENAME}-auog101uan02.dtb \
"

# imx-boot (flash.bin) targets based on UBOOT_CONFIG and IMXBOOT_VARIANT
IMXBOOT_TARGETS_SD = " \
    ${@bb.utils.contains('IMXBOOT_VARIANT', 'alt',       '${IMXBOOT_TARGETS_BASENAME}_alt', \
       bb.utils.contains('IMXBOOT_VARIANT', 'jailhouse', '${IMXBOOT_TARGETS_BASENAME}_jailhouse', \
       bb.utils.contains('IMXBOOT_VARIANT', 'netc',      '${IMXBOOT_TARGETS_BASENAME}_netc', \
       bb.utils.contains('IMXBOOT_VARIANT', 'rpmsg',     '${IMXBOOT_TARGETS_BASENAME}_lpboot_sm_a55', \
       bb.utils.contains('IMXBOOT_VARIANT', 'sof',       '${IMXBOOT_TARGETS_BASENAME}_a55', \
                                                         '${IMXBOOT_TARGETS_BASENAME}_all', d), d), d), d), d)} \
"

IMXBOOT_TARGETS = " \
    ${@bb.utils.contains('UBOOT_CONFIG', 'fspi', '${IMXBOOT_TARGETS_BASENAME}_a55_flexspi', '${IMXBOOT_TARGETS_SD}', d)} \
"

UBOOT_CONFIG = "8G"
UBOOT_CONFIG[8G] = "${UBOOT_CONFIG_BASENAME}_8G_defconfig,sdcard"
UBOOT_CONFIG[fspi] = "${UBOOT_CONFIG_BASENAME}_evk_fspi_defconfig"
```

## conf/machine/ecu150a1.conf
```bitbake
MACHINEOVERRIDES =. "ecu150a1:"

require conf/machine/imx8mqevk.conf

KERNEL_DEVICETREE_BASENAME = "${MACHINE}"

EVK_KERNEL_DEVICETREES := "${KERNEL_DEVICETREE}"
KERNEL_DEVICETREE:remove = "${EVK_KERNEL_DEVICETREES}"
KERNEL_DEVICETREE:append = " ./freescale/${KERNEL_DEVICETREE_BASENAME}.dtb"

SERIAL_CONSOLES = "115200;ttymxc0"

# Set DDR FIRMWARE
DDR_FIRMWARE_NAME = " \
    lpddr4_pmu_train_1d_imem.bin \
    lpddr4_pmu_train_1d_dmem.bin \
    lpddr4_pmu_train_2d_imem.bin \
    lpddr4_pmu_train_2d_dmem.bin \
"

UBOOT_DTB_NAME = "${MACHINE}.dtb"

DISTRO_FEATURES:remove = "wayland x11"
IMAGE_FEATURES:remove = "splash"
```

## conf/machine/rom2620-ed91.conf
```bitbake
require conf/machine/imx8ulp-lpddr4-evk.conf

KERNEL_DEVICETREE_BASENAME = "${MACHINE}"

EVK_KERNEL_DEVICETREES := "${KERNEL_DEVICETREE}"
KERNEL_DEVICETREE:remove = "${EVK_KERNEL_DEVICETREES}"
KERNEL_DEVICETREE:append = " ./freescale/${KERNEL_DEVICETREE_BASENAME}.dtb"

MACHINE_FEATURES:append = " soc-reva2"
MACHINE_FEATURES:remove = " soc-reva1"

IMXBOOT_TARGETS = "flash_singleboot_m33 flash_dualboot_m33"
```

## conf/machine/rom2820-ed93.conf
```bitbake
MACHINEOVERRIDES =. "imx93-11x11-lpddr4x-evk:rom2820-ed93:"

require conf/machine/imx93-11x11-lpddr4x-evk.conf

KERNEL_DEVICETREE_BASENAME = "${MACHINE}"

EVK_KERNEL_DEVICETREES := "${KERNEL_DEVICETREE}"
KERNEL_DEVICETREE:remove = "${EVK_KERNEL_DEVICETREES}"
KERNEL_DEVICETREE:append = " ./freescale/${KERNEL_DEVICETREE_BASENAME}.dtb"
```

## conf/machine/rom5620-db5901.conf
```bitbake
MACHINEOVERRIDES =. "rom5620:"

require conf/machine/imx8qxp-mek.conf

KERNEL_DEVICETREE_BASENAME = "${MACHINE}"

EVK_KERNEL_DEVICETREES := "${KERNEL_DEVICETREE}"
KERNEL_DEVICETREE:remove = "${EVK_KERNEL_DEVICETREES}"
KERNEL_DEVICETREE:append = " ./freescale/${KERNEL_DEVICETREE_BASENAME}.dtb"
```

## conf/machine/rom5720-db5901.conf
```bitbake
MACHINEOVERRIDES =. "rom5720:"

require conf/machine/imx8mq-lpddr4-wevk.conf

KERNEL_DEVICETREE_BASENAME = "${MACHINE}"

EVK_KERNEL_DEVICETREES := "${KERNEL_DEVICETREE}"
KERNEL_DEVICETREE:remove = "${EVK_KERNEL_DEVICETREES}"
KERNEL_DEVICETREE:append = " ./freescale/${KERNEL_DEVICETREE_BASENAME}.dtb"

UBOOT_DTB_NAME = "imx8mq-evk.dtb"
```

## conf/machine/rom5721-db5901.conf
```bitbake
MACHINEOVERRIDES =. "rom5721:"

require conf/machine/imx8mm-lpddr4-evk.conf

KERNEL_DEVICETREE_BASENAME = "${MACHINE}"

EVK_KERNEL_DEVICETREES := "${KERNEL_DEVICETREE}"
KERNEL_DEVICETREE:remove = "${EVK_KERNEL_DEVICETREES}"
KERNEL_DEVICETREE:append = " ./freescale/${KERNEL_DEVICETREE_BASENAME}.dtb"

UBOOT_DTB_NAME = "imx8mm-evk.dtb"
```

## conf/machine/rom5722-db2510.conf
```bitbake
MACHINEOVERRIDES =. "rom5722:"

require conf/machine/imx8mpevk.conf

KERNEL_DEVICETREE_BASENAME = "${MACHINE}"

EVK_KERNEL_DEVICETREES := "${KERNEL_DEVICETREE}"
KERNEL_DEVICETREE:remove = "${EVK_KERNEL_DEVICETREES}"
KERNEL_DEVICETREE:append = " ./freescale/${KERNEL_DEVICETREE_BASENAME}.dtb"

UBOOT_DTB_NAME = "imx8mp-evk.dtb"
```

## conf/machine/rsb3720.conf
```bitbake
MACHINEOVERRIDES =. "rsb3720:"

require conf/machine/imx8mpevk.conf

KERNEL_DEVICETREE_BASENAME = "${MACHINE}"

EVK_KERNEL_DEVICETREES := "${KERNEL_DEVICETREE}"
KERNEL_DEVICETREE:remove = "${EVK_KERNEL_DEVICETREES}"
KERNEL_DEVICETREE:append = " ./freescale/${KERNEL_DEVICETREE_BASENAME}.dtb"

SERIAL_CONSOLES = "115200;ttymxc2"

ATF_BOOT_UART_BASE = "0x30880000"

UBOOT_DTB_NAME = "imx8mp-evk.dtb"
```
