## conf/layer.conf
```bitbake
# We have a conf and classes directory, add to BBPATH
BBPATH .= ":${LAYERDIR}"

# We have recipes-* directories, add to BBFILES
BBFILES += "${LAYERDIR}/recipes-*/*/*.bb \
            ${LAYERDIR}/recipes-*/*/*.bbappend"

BBFILE_COLLECTIONS += "eecc-nxp"
BBFILE_PATTERN_eecc-nxp = "^${LAYERDIR}/"
BBFILE_PRIORITY_eecc-nxp = "9"
LAYERVERSION_eecc-nxp = "4"
LAYERSERIES_COMPAT_eecc-nxp = "mickledore"
```

## conf/machine/rom2620-ed91-desktop.conf
```bitbake
MACHINE="imx8ulpevk"
MACHINEOVERRIDES =. "imx8ulp-lpddr4-evk:"
require conf/machine/rom2620-ed91.conf

require conf/machine/include/ubuntubasics.inc
```
