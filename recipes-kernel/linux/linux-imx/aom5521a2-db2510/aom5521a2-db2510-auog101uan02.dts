// SPDX-License-Identifier: (GPL-2.0+ OR MIT)
/*
 * Copyright 2025 Advantech
 */

#include "imx95-19x19-evk.dts"

/ {
	model = "Advantech AOM-5521 A2 board";
};

/*
 * Step1. Include the difference set dtsi to remove some contents from EVK.
 */
#include "aom5521a2-db2510-difference.dtsi"

/*
 * Step2. The features of the device tree are added below
 */
#include "aom5521a2-db2510-usb3.dtsi"
#include "aom5521a2-db2510-gpioexp.dtsi"
#include "aom5521a2-db2510-gpio.dtsi"
#include "aom5521a2-db2510-usbotg.dtsi"
#include "aom5521a2-db2510-lpi2c2.dtsi"
#include "aom5521a2-db2510-lpi2c3.dtsi"
#include "aom5521a2-db2510-lpi2c7.dtsi"
#include "aom5521a2-db2510-lpi2c8.dtsi"
#include "aom5521a2-db2510-lpuart5.dtsi"
#include "aom5521a2-db2510-lpuart6.dtsi"
#include "aom5521a2-db2510-enet.dtsi"
#include "aom5521a2-db2510-enet-tg.dtsi"
#include "aom5521a2-db2510-flexspi1.dtsi"
#include "aom5521a2-db2510-flexspi1-nor-flash.dtsi"
#include "aom5521a2-db2510-lpspi4.dtsi"
#include "aom5521a2-db2510-lpspi4-nor-flash.dtsi"
#include "aom5521a2-db2510-can.dtsi"
#include "aom5521a2-db2510-pcie0.dtsi"
#include "aom5521a2-db2510-rtc-rx8900.dtsi"
#include "aom5521a2-db2510-pcie1-m2.dtsi"
#include "aom5521a2-db2510-wdt-msp430.dtsi"
#include "aom5521a2-db2510-sound-sgtl5000.dtsi"
#include "aom5521a2-db2510-i2c-eeprom.dtsi"
#include "aom5521a2-db2510-st33htpm.dtsi"
#include "aom5521a2-db2510-dsi-auog101uan02.dtsi"
#include "aom5521a2-db2510-gpiokey.dtsi"
#include "aom5521a2-db2510-cam-ov5640.dtsi"
